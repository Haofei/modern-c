ENTRY(_start)
SECTIONS {
    . = 0x80200000;            /* OpenSBI's default payload address on virt */
    .text : { KEEP(*(.text.boot)) *(.text*) }
    .rodata : { *(.rodata*) }
    .data : { *(.data*) }
    .bss : { *(.bss*) *(COMMON) }
    . = ALIGN(16);
    . = . + 0x10000;
    _stack_top = .;
}
